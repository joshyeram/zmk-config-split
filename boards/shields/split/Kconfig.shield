## boards/shields/split/Kconfig.shield
```kconfig
config SHIELD_SPLIT_LEFT
    def_bool $(shields_list_contains,splitLeft)

config SHIELD_SPLIT_RIGHT
    def_bool $(shields_list_contains,splitRight)

config SHIELD_SPLIT_DONGLE
	def_bool $(shields_list_contains,splitDongle)
```

## config/boards/shields/split/Kconfig.defconfig
```kconfig
# Copyright (c) 2020 The ZMK Contributors
# SPDX-License-Identifier: MIT

if SHIELD_SPLIT_DONGLE

config ZMK_KEYBOARD_NAME
	default "split"
	
config ZMK_SPLIT_BLE_ROLE_CENTRAL
	default y
	
config ZMK_USB
	default y

config ZMK_WPM
	defualt y

endif

if SHIELD_SPLIT_LEFT || SHIELD_SPLIT_RIGHT || SHIELD_SPLIT_DONGLE

config ZMK_SPLIT
	default y

config ZMK_BLE
	default y
	
endif
```

## config/boards/shields/split/Kconfig.shield
```kconfig
config SHIELD_splitLeft
    def_bool $(shields_list_contains,splitLeft)

config SHIELD_splitRight
    def_bool $(shields_list_contains,splitRight)

config SHIELD_splitDongle
	def_bool $(shields_list_contains,splitDongle)
```

## config/west.yml
```yaml
manifest:
  remotes:
    - name: zmkfirmware
      url-base: https://github.com/zmkfirmware
    - name: joshyeram                            # <--- add this
      url-base: https://github.com/joshyeram    # <--- and this
    # Additional modules containing boards/shields/custom code can be listed here as well
    # See https://docs.zephyrproject.org/3.2.0/develop/west/manifest.html#projects
  projects:
    - name: zmk
      remote: joshyeram
      revision: removeUSBpowercheck
      import: app/west.yml
    - name: prospector-zmk-module
      remote: joshyeram
      revision: support_nicenano                            # <---
  self:
    path: config
```
